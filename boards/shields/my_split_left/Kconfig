## config/boards/shields/corne_xiao_left/Kconfig.defconfig
```kconfig
if SHIELD_CORNE_XIAO_LEFT

config ZMK_KEYBOARD_NAME
    default "Corne XIAO"

config ZMK_SPLIT_ROLE_CENTRAL
    default y

config ZMK_SPLIT
    default y

endif
```

## config/boards/shields/corne_xiao_left/Kconfig.shield
```kconfig
config SHIELD_CORNE_XIAO_LEFT
    def_bool $(shields_list_contains,corne_xiao_left)
```

## config/boards/shields/corne_xiao_right/Kconfig.defconfig
```kconfig
if SHIELD_CORNE_XIAO_RIGHT

config ZMK_KEYBOARD_NAME
    default "Corne XIAO Right"

config ZMK_SPLIT
    default y

endif
```

## config/boards/shields/corne_xiao_right/Kconfig.shield
```kconfig
config SHIELD_CORNE_XIAO_RIGHT
    def_bool $(shields_list_contains,corne_xiao_right)
```

## config/boards/shields/my_split_right/Kconfig
```kconfig
config SHIELD_MY_SPLIT_RIGHT
    bool "My Split Right"
    select SHIELD_MY_SPLIT
```
