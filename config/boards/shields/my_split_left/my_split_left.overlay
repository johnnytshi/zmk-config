/ {
    kscan {
        compatible = "zmk,kscan-gpio-matrix";
        label = "KSCAN_LEFT";

        row-gpios = <
            &gpio0 2  GPIO_ACTIVE_LOW
            &gpio0 3  GPIO_ACTIVE_LOW
        >;
        col-gpios = <
            &gpio1 5  GPIO_ACTIVE_LOW
            &gpio1 6  GPIO_ACTIVE_LOW
            &gpio1 7  GPIO_ACTIVE_LOW
        >;

        diode-direction = "ROW2COL";

        polling-delay-ms = <1>;
        debounce-press-ms = <5>;
        debounce-release-ms = <5>;
    };
};

/ {
    chosen {
        zmk,kscan = &kscan_left;
    };

    zmk,position-offset = <0>;
};
