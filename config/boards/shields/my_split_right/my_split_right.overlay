/ {
    kscan {
        compatible = "zmk,kscan-gpio-matrix";
        label = "KSCAN_RIGHT";

        row-gpios = <
            &gpio0 8  GPIO_ACTIVE_LOW
            &gpio0 9  GPIO_ACTIVE_LOW
        >;
        col-gpios = <
            &gpio1 10 GPIO_ACTIVE_LOW
            &gpio1 11 GPIO_ACTIVE_LOW
            &gpio1 12 GPIO_ACTIVE_LOW
        >;

        diode-direction = "ROW2COL";

        polling-delay-ms = <1>;
        debounce-press-ms = <5>;
        debounce-release-ms = <5>;
    };
};

/ {
    chosen {
        zmk,kscan = &kscan_right;
    };

    zmk,position-offset = <6>;
};
