/*
 * Copyright (c) 2020 Pete Johanson
 *
 * SPDX-License-Identifier: MIT
 */

#include "chipper.dtsi"

&kscan0 {
	col-gpios
		= <&gpio0 10 (GPIO_ACTIVE_LOW | GPIO_PULL_UP)>   //Col0
		, <&gpio1 15 (GPIO_ACTIVE_LOW | GPIO_PULL_UP)>   //Col1
		, <&gpio1 14 (GPIO_ACTIVE_LOW | GPIO_PULL_UP)>   //Col2
		, <&gpio1 13 (GPIO_ACTIVE_LOW | GPIO_PULL_UP)>   //Col3
		, <&gpio1 12 (GPIO_ACTIVE_LOW | GPIO_PULL_UP)>   //Col4
		, <&gpio1 11 (GPIO_ACTIVE_LOW | GPIO_PULL_UP)>   //Col5
		;
};
