/*
 * Copyright (c) 2020 Pete Johanson
 *
 * SPDX-License-Identifier: MIT
 */

#include "chipper.dtsi"

&kscan0 {
	row-gpios
		= <&gpio0 10 GPIO_ACTIVE_HIGH>   //Row0 (was Col0)
		, <&gpio1 15 GPIO_ACTIVE_HIGH>   //Row1 (was Col1)
		, <&gpio1 14 GPIO_ACTIVE_HIGH>   //Row2 (was Col2)
		, <&gpio1 13 GPIO_ACTIVE_HIGH>   //Row3 (was Col3)
		, <&gpio1 12 GPIO_ACTIVE_HIGH>   //Row4 (was Col4)
		, <&gpio1 11 GPIO_ACTIVE_HIGH>   //Row5 (was Col5)
		;
};
